#include "snake.h"
U8G2_SH1106_128X64_NONAME_F_HW_I2C u8g2(U8G2_R0, U8X8_PIN_NONE);

void Snake::gamePause()
{
	delay(1000);
	while (digitalRead(PAUSE)) {}
}

byte Snake::aRead()
{
	float x = analogRead(1);
	float y = analogRead(0);

	if (x > 800.0)
		return RIGHT;

	if (x < 200.0)
		return LEFT;

	if (y > 800.0)
		return UP;

	if (y < 200.0)
		return DOWN;

	return NO_MOVE;
}

void Snake::dFrame()
{
	u8g2.drawFrame(0, 0, 126, 64);
	u8g2.drawFrame(1, 1, 124, 62);
	u8g2.drawFrame(2, 2, 122, 60);
	u8g2.drawFrame(3, 3, 120, 58);
	u8g2.drawLine(121, 0, 121, 63);
	u8g2.drawLine(120, 0, 120, 63);
}

apple Snake::dApple()
{
	apple a;
	a.x = 4 * random(1, 30);
	a.y = 4 * random(1, 15);
	return a;
}

snake Snake::dSnake()
{
	snake s;
	s.x.reserve(100);
	s.y.reserve(100);
	s.x.push_back(4 * random(2, 29));
	s.y.push_back(4 * random(2, 14));
	if (random(0, 2)) {
		if (round(s.x[0] / 28))
			s.side = 2;
		else
			s.side = 4;
	}
	else {
		if (round(s.y[0] / 13))
			s.side = 3;
		else
			s.side = 1;
	}
	dSnakePath(s);
	return s;
}

void Snake::dSnakePath(snake s)
{
	for (byte i = 0; i < s.x.size(); i++) {
		u8g2.drawBox(s.x[i], s.y[i], 4, 4);
	}
}

void Snake::dApplePath(apple a)
{
	u8g2.drawBox(a.x, a.y, 4, 4);
}

void Snake::moveSnakePath(snake& s)
{
	switch (s.side) {
	case UP:
		s.x.insert(s.x.begin(), s.x[0]);
		s.y.insert(s.y.begin(), s.y[0] - 2);
		s.y.pop_back();
		s.x.pop_back();
		break;
	case RIGHT:
		s.x.insert(s.x.begin(), s.x[0] - 2);
		s.y.insert(s.y.begin(), s.y[0]);
		s.y.pop_back();
		s.x.pop_back();
		break;
	case DOWN:
		s.x.insert(s.x.begin(), s.x[0]);
		s.y.insert(s.y.begin(), s.y[0] + 2);
		s.y.pop_back();
		s.x.pop_back();
		break;
	case LEFT:
		s.x.insert(s.x.begin(), s.x[0] + 2);
		s.y.insert(s.y.begin(), s.y[0]);
		s.y.pop_back();
		s.x.pop_back();
		break;
	}
}

bool Snake::frameCollision(snake s)
{
	if (s.x[0] > 116 || s.x[0] < 4)
		return 0;
	if (s.y[0] > 56 || s.y[0] < 4)
		return 0;
	return 1;
}

void Snake::gameOver(unsigned int score)
{
	u8g2.clearBuffer();
	dFrame();
	u8g2.setFont(u8g2_font_lucasarts_scumm_subtitle_o_tf);
	u8g2.drawStr(10, 22, "GAME OVER");
	String s = "SCORE: " + String(score);
	char c[11];
	s.toCharArray(c, 11);
	u8g2.drawStr(22, 42, c);
	u8g2.nextPage();
	delay(2000);
}

void Snake::showAS(snake s, apple a)
{
	Serial.println("Snake: " + String(s.x[0]) + " " + String(s.y[0]) + " " + String(s.side));
	Serial.println("Apple: " + String(a.x) + " " + String(a.y));
	for (byte i = 0; i < s.x.size(); i++) {
		Serial.println("[" + String(i) + "] x=" + String(s.x[i]) + ", y=" + String(s.y[i]));
	}
}

void Snake::eat(snake& s, apple& a)
{
	byte last = s.x.size() - 1;
	switch (s.side) {
	case UP:
		if (s.x[0] == a.x && s.y[0] == a.y + 4) {
			s.y.push_back(s.y[last] + 4);
			s.x.push_back(s.x[last]);
			a = dApple();
		}
		break;
	case RIGHT:
		if (s.x[0] == a.x + 4 && s.y[0] == a.y) {
			s.y.push_back(s.y[last]);
			s.x.push_back(s.x[last] + 4);
			a = dApple();
		}
		break;
	case DOWN:
		if (s.x[0] == a.x && s.y[0] == a.y - 4) {
			s.y.push_back(s.y[last] - 4);
			s.x.push_back(s.x[last]);
			a = dApple();
		}
		break;
	case LEFT:
		if (s.x[0] == a.x - 4 && s.y[0] == a.y) {
			s.y.push_back(s.y[last]);
			s.x.push_back(s.x[last] - 4);
			a = dApple();
		}
		break;
	}
}

void Snake::moveBlock(snake& s, apple& a)
{
	u8g2.clearBuffer();
	dFrame();
	eat(s, a);
	moveSnakePath(s);
	dSnakePath(s);
	dApplePath(a);
	u8g2.nextPage();
}

bool Snake::snakeCollision(snake s)
{
	for (byte i = 1; i < s.x.size(); i++) {
		if (s.x[0] == s.x[i] && s.y[0] == s.y[i])
			return 0;
	}
	return 1;
}

void Snake::menu()
{
   static const unsigned char snake_bits[] PROGMEM = {
   0x00, 0x00, 0xfe, 0xff, 0x3f, 0x00, 0x00, 0x00, 0x00, 0x00, 0xff, 0xff,
   0x7f, 0x00, 0x00, 0x00, 0x00, 0x80, 0xff, 0xff, 0xff, 0x00, 0x00, 0x00,
   0x00, 0xc0, 0xff, 0xff, 0xff, 0x01, 0x00, 0x00, 0x00, 0xe0, 0x07, 0x00,
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   0x00, 0xfe, 0xff, 0xff, 0xff, 0x7f, 0x00, 0x07 };
	u8g2.clearBuffer();
	u8g2.setFont(u8g2_font_lucasarts_scumm_subtitle_o_tf);
	u8g2.drawStr(64, 15, "SNAKE");
	u8g2.drawStr(67, 30, "GAME");
  u8g2.setFont(u8g2_font_tom_thumb_4x6_t_all);
	u8g2.drawStr(64, 44, "MOVE TO START");
	u8g2.drawStr(80, 54, "CREATED BY");
  u8g2.setFont(u8g2_font_7x13B_tf);
  u8g2.drawStr(80, 64, "DARCIA");
  u8g2.drawXBMP( 0, 0, 64, 64, snake_bits);
	u8g2.nextPage();
  while(digitalRead(PAUSE)&&!aRead()){}
}

void Snake::init(){
  u8g2.begin();
}

void Snake::showScore(){
  
  u8g2.clearBuffer();
  u8g2.setFont(u8g2_font_lucasarts_scumm_subtitle_o_tf);
  u8g2.drawStr(30, 15, "BEST SCORES");
  u8g2.setFont(u8g2_font_tom_thumb_4x6_t_all);
  
  u8g2.nextPage();
  while(digitalRead(PAUSE)&&!aRead()){}
}

void Snake::addScore(unsigned int score){
  EEPROM[0]=0;
}

int freeRam() {
	extern int __heap_start, * __brkval;
	int v;
	return (int)& v - (__brkval == 0 ? (int)& __heap_start : (int)__brkval);
}

