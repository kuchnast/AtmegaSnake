#pragma once

#include <avr/pgmspace.h>

#include "Config.hpp"
#include "SnakeGame.hpp"
#include "DigitalPin.hpp"
#include "Keyboard.hpp"

static const unsigned char snake_bits[] PROGMEM = {
    0x00, 0x00, 0xfe, 0xff, 0x3f, 0x00, 0x00, 0x00, 0x00, 0x00, 0xff, 0xff,
    0x7f, 0x00, 0x00, 0x00, 0x00, 0x80, 0xff, 0xff, 0xff, 0x00, 0x00, 0x00,
    0x00, 0xc0, 0xff, 0xff, 0xff, 0x01, 0x00, 0x00, 0x00, 0xe0, 0x07, 0x00,
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    0x00, 0xfe, 0xff, 0xff, 0xff, 0x7f, 0x00, 0x07};

class Menu
{
private:
    Display &display_;

public:
    Menu(Display &display): display_(display) {}

    void showSnakeScrean()
    {
        display_.firstPage();
        do
        {
            display_.clearBuffer();
            display_.setFont(u8g2_font_lucasarts_scumm_subtitle_o_tf);
            display_.drawStr(64, 15, "SNAKE");
            display_.drawStr(67, 30, "GAME");
            display_.setFont(u8g2_font_5x8_tf);
            display_.drawStr(88, 44, "MOVE");
            display_.drawStr(92, 54, "TO");
            display_.drawStr(86, 64, "START");
            display_.drawXBMP(0, 0, 64, 64, snake_bits);
        } while (display_.nextPage());
    }

    void showWelcomeScrean(bool invert)
    {
        display_.firstPage();
        display_.setFont(u8g2_font_lucasarts_scumm_subtitle_o_tf);
        do
        {
            if(invert)
            {
                display_.drawBox(0, 0, 128, 64);
                display_.setDrawColor(0);
                display_.drawStr(20, 40, "WELCOME");
                display_.setDrawColor(1);
            }
            else
            {
                display_.drawStr(20, 40, "WELCOME");
            }
        } while (display_.nextPage());
    }

    void ShowMainMenu(uint8_t highlight_opt)
    {
        display_.firstPage();
        do
        {
            display_.clearBuffer();
            display_.setFont(u8g2_font_6x12_me);
            display_.setFontMode(0);

            if(highlight_opt == 0)
                display_.setDrawColor(0);
            else
                display_.setDrawColor(1);
            display_.drawStr(36, 15, "PLAY SNAKE");

            if (highlight_opt == 1)
                display_.setDrawColor(0);
            else
                display_.setDrawColor(1);
            display_.drawStr(36, 30, "HIGH SCORE");

            if (highlight_opt == 2)
                display_.setDrawColor(0);
            else
                display_.setDrawColor(1);
            display_.drawStr(45, 45, "SETINGS");

            if (highlight_opt == 3)
                display_.setDrawColor(0);
            else
                display_.setDrawColor(1);
            display_.drawStr(50, 60, "EXIT");
        } while (display_.nextPage());
    }

    void ShowSetingsMenu(uint8_t highlight_opt)
    {
        display_.firstPage();
        do
        {
            display_.clearBuffer();
            display_.setFont(u8g2_font_6x12_me);
            display_.setFontMode(0);

            if (highlight_opt == 0)
                display_.setDrawColor(0);
            else
                display_.setDrawColor(1);
            display_.drawStr(36, 15, "PLAY SNAKE");

            if (highlight_opt == 1)
                display_.setDrawColor(0);
            else
                display_.setDrawColor(1);
            display_.drawStr(36, 30, "HIGH SCORE");

            if (highlight_opt == 2)
                display_.setDrawColor(0);
            else
                display_.setDrawColor(1);
            display_.drawStr(45, 45, "SETINGS");

            if (highlight_opt == 3)
                display_.setDrawColor(0);
            else
                display_.setDrawColor(1);
            display_.drawStr(50, 60, "EXIT");
        } while (display_.nextPage());
    }
};